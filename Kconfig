## Kconfig
```kconfig
menu "syslog"

    config USE_SYSLOG
        bool "Enable remote syslog via UDP"
        default n

    config EVENTGROUP_NAME
        string "Name of app's main event group"
        default appState
        depends on USE_SYSLOG
        help
            The main event group in the app using syslog.
            It must have one free event bit available for syslog itself. Furthermore,
            it must provide 2 bits for Wifi connection state and NTP synchronization state.
            This gets declared as extern EventGroupHandle_t.

    config MSG_QUEUED_VALUE
        string "The value of the MSG_QUEUED bit in the event group"
        default "BIT5"
        depends on USE_SYSLOG
        help
            The value of a const int representing the MSG_QUEUED state bit value.
            This gets assigned as the value of static const int SYSLOG_QUEUED.

    config WIFI_CONNECTED
        string "Name of the WIFI_CONNECTED bit in the event group"
        default "WIFI_CONNECTED"
        depends on USE_SYSLOG
        help
            The name of a const int representing the WIFI_CONNECTED state bit value.
            This gets declared as extern const int.

    config NTP_SYNCED
        string "Name of the NTP_SYNCED bit in the event group"
        default "NTP_SYNCED"
        depends on USE_SYSLOG
        help
            The name of a const int representing the NTP_SYNCED state bit value.
            This gets declared as extern const int.

    config SYSLOG_HOST
        string "Syslog destination"
        default "loghost.fe.think"
        help
            The host name or IP of the syslog server.
            If a non-standard port is required, specify it by appending it with a colon. E.g.:
            192.168.1.1:515

    config SYSLOG_MINHEAP
        int "Minimum heap size in bytes"
        default 8192
        depends on USE_SYSLOG
        help
            If free heap space is less than this value, syslog will
            discard messages until free space grows above this value again.

    config SYSLOG_FILTER
        int "Minimum severity for sending"
        default 7
        depends on USE_SYSLOG
        help
            A severity numerical higher than this will be dropped instead of being queued/send

    config SYSLOG_SENDDATE
        bool "Enable sending a timestamp"
        default y
        depends on USE_SYSLOG
        help
            If enabled, send a timestamp with every message (requires time synced via NTP and
            the TZ environment variable correctly initialized.

endmenu
```
